#include "includes.h"
#include "display.h"
#include "meter.h"
#include "usart.h"
#include "usart3.h"
#include "rtc.h" 
#include "def.h"


static u8 holdReg[DEV_REC_LEN];//缓存设备应答有效数据
extern USART_COM com3;//定义关于串口3的使用
extern calendar STM32_calendar;//stm32时钟结构体  u32 EleTemp;//电能初值
extern char Start_normal[];
extern char Start_abnormal[];

WUI wuiSensor;





static const unsigned char auchCRCHi[] = {
0x00, 0xC1, 0x81, 0x40, 0x01, 0xC0, 0x80, 0x41, 0x01, 0xC0, 
0x80, 0x41, 0x00, 0xC1, 0x81, 0x40, 0x01, 0xC0, 0x80, 0x41, 
0x00, 0xC1, 0x81, 0x40, 0x00, 0xC1, 0x81, 0x40, 0x01, 0xC0, 
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0x80, 0x41, 0x00, 0xC1, 0x81, 0x40
};

static const unsigned char  auchCRCLo[] = {
0x00, 0xC0, 0xC1, 0x01, 0xC3, 0x03, 0x02, 0xC2, 0xC6, 0x06, 
0x07, 0xC7, 0x05, 0xC5, 0xC4, 0x04, 0xCC, 0x0C, 0x0D, 0xCD, 
0x0F, 0xCF, 0xCE, 0x0E, 0x0A, 0xCA, 0xCB, 0x0B, 0xC9, 0x09, 
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0x43, 0x83, 0x41, 0x81, 0x80, 0x40
};



/*
功  能：循环冗余校验函数
参  数：校验数组 指明了需要校验的字符型数组名
	    数组长度 指明了需要校验的元素个数
返回值：校验码
*/
u16 CRC16(unsigned char *puchMsg, unsigned char usDataLen)
{
	unsigned char uchCRCHi = 0xFF ; /* 高CRC字节初始化 */
	unsigned char uchCRCLo = 0xFF ; /* 低CRC 字节初始化 */
	unsigned char uIndex ; /* CRC循环中的索引 */
	unsigned char cnt=0;																																																																																																																																																																																																																																										
	do{					 /* 传输消息缓冲区 */
		uIndex = uchCRCHi ^ *puchMsg++ ; /* 计算CRC */
		uchCRCHi = uchCRCLo ^ auchCRCHi[uIndex] ;
		uchCRCLo = auchCRCLo[uIndex] ;
		cnt++;
	}while(cnt < usDataLen);

	return (uchCRCHi << 8 | uchCRCLo);
}

//接收数据报校验
char RecPakChk(unsigned char *buf,unsigned char LenOfRecPak) 
{ 
	unsigned int ChkSum;
	ChkSum = (unsigned int)buf[LenOfRecPak-2]*256+(unsigned int)buf[LenOfRecPak-1];
	if(CRC16(buf,LenOfRecPak-2)==ChkSum)
	{
		return 1;
	}
	else 
	{
		return 0;
	}
}




u8 Search_meter(void)//查询电表读数
{
		int i=0,j=0;
		u8 flag=0;
		u16 ChkSum;
		u8 err;
		u16 RegAddr=DEV_REG_START;
		u16 RegNum=DEV_REG_NUM;
		for(i=0;i<10;i++)
		{
				com3.DMA_TX_BUF[0]=1;
				com3.DMA_TX_BUF[1]=READ_HOLDING_REGISTERS;
				com3.DMA_TX_BUF[2]=RegAddr>>8;
				com3.DMA_TX_BUF[3]=RegAddr;
				com3.DMA_TX_BUF[4]=RegNum>>8;
				com3.DMA_TX_BUF[5]=RegNum;
				ChkSum=CRC16(com3.DMA_TX_BUF,6);
				com3.DMA_TX_BUF[6]=ChkSum>>8;
				com3.DMA_TX_BUF[7]=ChkSum;
				
				DIR3(WRITE);	//置通讯方向为发送		
				for(j=0;j<8;j++)//发送查询指令
				{
					USART_SendData(USART3, (u8) com3.DMA_TX_BUF[j]);
					while(USART_GetFlagStatus(USART3, USART_FLAG_TC) == RESET){}//等待传送结束
				}
				DIR3(READ);	//反转通讯方向为接收
				OSTimeDlyHMSM(0, 0,0,40);
				OSSemPend(com3.sem_DMA_RX,DEV_TIMEOUT,&err);//等待电表响应，超时出错则不处理
				if(err==OS_ERR_NONE)
				{
				//解析电表数据
					if(com3.DMA_RX_BUF[0]==com3.DMA_TX_BUF[0])//地址对
					{
						if(com3.DMA_RX_BUF[1]==com3.DMA_TX_BUF[1])//指令对
						{
							if(RecPakChk(com3.DMA_RX_BUF,com3.lenRec))//校验对
							{
								
								for(i=0;i<com3.lenRec-2;i++)holdReg[i]=com3.DMA_RX_BUF[i+3];//复制有效数据
								//数据分捡，把字节数据，根据电表定义，合成有效使用数据
								wuiSensor.W=(holdReg[0]<<24)+(holdReg[1]<<16)+(holdReg[2]<<8)+holdReg[3];
								wuiSensor.U=(holdReg[12]<<8) + holdReg[13];
								wuiSensor.I=(holdReg[14]<<24)+(holdReg[15]<<16)+(holdReg[16]<<8)+holdReg[17];
								flag=1;
								break;
						}
					}
				}
			}
		}
	return flag;
}
u8 Selfcheck_meter(void)
{
		int i=0,j=0;
		u8 temp=0;
		u16 ChkSum;
		u8 err;
		u16 RegAddr=DEV_REG_START;
		u16 RegNum=DEV_REG_NUM;
		for(i=0;i<10;i++)
		{
				com3.DMA_TX_BUF[0]=1;
				com3.DMA_TX_BUF[1]=READ_HOLDING_REGISTERS;
				com3.DMA_TX_BUF[2]=RegAddr>>8;
				com3.DMA_TX_BUF[3]=RegAddr;
				com3.DMA_TX_BUF[4]=RegNum>>8;
				com3.DMA_TX_BUF[5]=RegNum;
				ChkSum=CRC16(com3.DMA_TX_BUF,6);
				com3.DMA_TX_BUF[6]=ChkSum>>8;
				com3.DMA_TX_BUF[7]=ChkSum;
				
				DIR3(WRITE);	//置通讯方向为发送		
				for(j=0;j<8;j++)//发送查询指令
				{
					USART_SendData(USART3, (u8) com3.DMA_TX_BUF[j]);
					while(USART_GetFlagStatus(USART3, USART_FLAG_TC) == RESET){}//等待传送结束
				}
				DIR3(READ);	//反转通讯方向为接收
				OSTimeDlyHMSM(0, 0,0,40);
				OSSemPend(com3.sem_DMA_RX,DEV_TIMEOUT,&err);//等待电表响应，超时出错则不处理
				if(err==OS_ERR_NONE)
				{
				//解析电表数据
					if(com3.DMA_RX_BUF[0]==com3.DMA_TX_BUF[0])//地址对
					{
						if(com3.DMA_RX_BUF[1]==com3.DMA_TX_BUF[1])//指令对
						{
							if(RecPakChk(com3.DMA_RX_BUF,com3.lenRec))//校验对
							{
								temp++;
							}
						}
					}
				}
		}
	return temp;
}

void meter_inspect(void)
{
	if(Search_meter())
	{
		write_Text(0x0620,Start_normal);
	}else
	{
		write_Text(0x0620,Start_abnormal);
	}
}


	
